#include <dt-bindings/zmk/matrix.h>

&kscan0 {
	compatible = "zmk,kscan-gpio-matrix";
	label = "KSCAN";
	diode-direction = "col2row";

	row-gpios
		= <&gpio0 6 (GPIO_ACTIVE_HIGH | GPIO_PULL_DOWN)>	// ROW0: P0.06
		, <&gpio0 8 (GPIO_ACTIVE_HIGH | GPIO_PULL_DOWN)>	// ROW1: P0.08
		, <&gpio0 17 (GPIO_ACTIVE_HIGH | GPIO_PULL_DOWN)>	// ROW2: P0.17
		, <&gpio0 20 (GPIO_ACTIVE_HIGH | GPIO_PULL_DOWN)>	// ROW3: P0.20
		, <&gpio0 22 (GPIO_ACTIVE_HIGH | GPIO_PULL_DOWN)>	// ROW4: P0.22
		, <&gpio0 24 (GPIO_ACTIVE_HIGH | GPIO_PULL_DOWN)>	// ROW5: P0.24
		, <&gpio1 0 (GPIO_ACTIVE_HIGH | GPIO_PULL_DOWN)>	// ROW6: P1.00
		, <&gpio0 11 (GPIO_ACTIVE_HIGH | GPIO_PULL_DOWN)>	// ROW7: P0.11
		, <&gpio1 4 (GPIO_ACTIVE_HIGH | GPIO_PULL_DOWN)>	// ROW8: P1.04
		;

	col-gpios
		= <&gpio0 31 GPIO_ACTIVE_HIGH>	// COL0: P0.31-LF
		, <&gpio0 29 GPIO_ACTIVE_HIGH>	// COL1: P0.29-LF
		, <&gpio0 2 GPIO_ACTIVE_HIGH>	// COL2: P0.02-LF
		, <&gpio1 15 GPIO_ACTIVE_HIGH>	// COL3: P1.15-LF
		, <&gpio1 13 GPIO_ACTIVE_HIGH>	// COL4: P1.13-LF
		, <&gpio1 11 GPIO_ACTIVE_HIGH>	// COL5: P1.11-LF
		, <&gpio0 10 GPIO_ACTIVE_HIGH>	// COL6: P0.10-LF
		;
};

&ext_power {
	control-gpios = <&gpio1 6 GPIO_ACTIVE_LOW>;	// EXT_PWR: P1.06-LF
};
